/dts-v1/;

// QEMU's `virt` machine: any Linux computer, no phone needed.
/ {
	name = "qemu-virt";
	description = "QEMU virt (aarch64)";
	soc = "qemu-virt";

	features = "virtio";                    // its network card, tablet, keyboard, disk and sound are virtio devices

	// No panel to tell: the display driver darkens the picture itself.
	backlight {
		type = "soft";
	};

	// The loader's fallback: a machine whose display matches no board is taken for the emulator.
	loader {
	};
};
