/dts-v1/;

// A board file with every key, explained. `tools/boards.py new NAME --soc SOC --dts FILE` writes a
// shorter one with what your device tree says; this is the reference. Documentation/porting.md is the guide.

/ {
	name = "NAME";                          // the directory's name, and what the loader puts in /chosen/darwin-board
	description = "Maker Model";            // for people: logs, hw.board.description, tools/boards.py list
	soc = "sm0000";                         // the name in soc.dtsi beside it: where the blocks of the chip are

	// The drivers this board may start. Empty at first: add one once its driver has been seen to work
	// here, in the order of Documentation/porting.md. The kernel knows these:
	// cpufreq-epss    CPU frequency through Qualcomm's EPSS (boot-arg cpufreq=1); needs cpufreq { } in the SoC file
	// cpufreq-scmi    firmware CPU performance queries (scmi_perf=1); needs scmi-perf { } in the SoC file
	// ddr-rpmh        memory bandwidth votes through RPMh (ddr=); needs rpmh { } in the SoC file
	// battery-uefi    the battery as the firmware reports it to the loader (battery=1); needs uefi-charger in
	// loader { }
	// buttons-pmic    power and volume keys on the PMIC through the SPMI arbiter (buttons=1); needs buttons { },
	// and spmi { } in the SoC file
	// adsp            the audio DSP: sound, and the battery manager behind it (adsp=1); needs adsp { }
	// display-scan    a command-mode panel: frames are written ahead of its readout, read from the DSI
	// interface's counters (fb_scan); needs intf1 in the SoC file's display { }
	// virtio          an emulator's virtio devices (network, tablet, keyboard): for QEMU's board, not a phone
	// gpu-a660        an Adreno of the A660 family (642, 642L, 643, 660 ...) behind a GMU (gpu=1); needs gpu { }
	// and these, each a driver of one part wired the way one phone has it -- list one only if your phone
	// has that part on the same pins and bus (drivers/board/board.h, Documentation/drivers.md):
	// touch-goodix, touch-ft3658u, touch-ft5x06, speaker-aw88261, haptic-aw86927, imu-lsm6dso, imu-bmi160, torch-pm8350c,
	// camera-sm7325, wifi-wcn6750, mic-wcd938x, modem-sm7325, bluetooth-wcn-uart
	// Documentation/features.md has what each needs written down first; tools/boards.py status NAME says it for
	// this board.
	features = <>;

	// The panel's light (Documentation/backlight.md).
	backlight {
		type = "soft";                  // "dcs": MIPI DCS 0x51 through the DSI controller (most AMOLED panels);
		                                // "soft": the picture is darkened in software, which works anywhere;
		                                // "none": nothing
		// For "dcs", from the panel's node in the Android device tree:
		// panel-mode = "command";      // qcom,mdss-dsi-panel-type: dsi_cmd_mode -> "command", dsi_video_mode -> "video"
		// min = <1>;                   // qcom,mdss-dsi-bl-min-level
		// max = <2047>;                // qcom,mdss-dsi-bl-max-level (without the panel's high-brightness range)
		// restore = <307>;             // qcom,mdss-brightness-init-level: the panel is left at this for the loader
		// bytes = <2>;                 // 2 when max is above 255
		// byte-order = "msb-first";    // "msb-first" when the node has qcom,mdss-dsi-bl-inverted-dbv, else "lsb-first"
	};

	// Holding the processors back when hot (Documentation/thermal.md). Leave the section out until thermal { } and
	// cpufreq { } are in the SoC file.
	// thermal {
		// floor-mhz = <1000 1100 1100>; // the slowest each group of cores is held back to: one value for each
		//                              // group of the SoC file's cpufreq { } domain-cores
	// };

	// The keys, for the feature "buttons-pmic". A peripheral is SPMI slave << 8 | the high byte of its
	// registers; `tools/boards.py new --dts` works both out from the tree.
	// buttons {
		// pon = <0x013>;               // the power-on block (pon_hlos@1300 under the PMIC with reg = <0 ...>): power on
		//                              // KPDPWR_N, volume down on RESIN_N
		// pon-name = "the PMK8350's power-on block"; // for the log
		// volume-up = <0x18d>;         // the GPIO of gpio_keys' volume-up: GPIO n of pinctrl@8800 is 0x88 + n - 1,
		//                              // on the slave its PMIC is (qcom,pm8350@1: 1)
		// volume-up-name = "GPIO6 of the PM8350";
	// };

	// The PMIC's real-time clock: a count of seconds that runs on while the phone is off, read once at boot
	// (board/rtc.c, hw.rtc_seconds; rtc=0 leaves it alone). Nothing is ever written to it. Leave the section
	// out and the clock is not read. A peripheral as in buttons { }; `tools/boards.py new --dts` finds it.
	// rtc {
		// peripheral = <0x061>;        // its RTC_RW block: rtc@6100 of the PMK8350 (SM8350, SM7325 and after), or
		//                              // rtc@6000 of the PM8150 / PM8250 / PM8998 before it (0x060), on the slave its
		//                              // PMIC is (qcom,pmk8350@0: 0)
		// name = "the PMK8350's RTC";  // for the log
	// };

	// The port's own partition on the phone's storage: the one partition the kernel may write (ufs_write=1),
	// and only from the block past what the build puts at its start. Leave the section out and nothing is
	// ever written; reading the storage needs none of this. The partition is named "darwin"; these are its
	// GPT entry as you made it (sgdisk -i N /dev/block/sda, or parted's "unit s print").
	// storage {
		// type-guid = "7c3457ef-0000-11aa-aa11-00306543ecac"; // "Partition GUID code"
		// unique-guid = "fd6854ad-24aa-4fc3-94fe-290116858d68"; // "Partition unique GUID"
		// first-lba = <25374720>;      // "First sector", in the storage's blocks of 4096 bytes
		// last-lba = <30617594>;       // "Last sector"
		// write-first = <2042368>;     // the partition's first block that is not the build's: past the Darwin volume and
		//                              // what follows it (tools/darwin-write.py prints where they end)
	// };

	// The touch controller's wiring, for a feature "touch-...": the SPI serial engine it is on, that engine's
	// clocks in the clock controller, its pins and its supplies. The controller's node in the device tree is
	// under its bus's node (qupv3_seN_spi); the numbers below are one phone's.
	// touch {
		// serial-engine = <0x00a94000>; // the bus's node: reg (qupv3_se13_spi: spi@a94000)
		// clocks = <0x18004 0x18008 0x185fc>; // in the clock controller (gcc-SOC.c): the wrapper's two bus clocks,
		//                              // gcc_qupv3_wrap_N_m_ahb_clk and ..._s_ahb_clk, and the engine's own,
		//                              // gcc_qupv3_wrapN_sM_clk: each one's halt_reg
		// vote-register = <0x52008>;   // the same file: the enable_reg of those clocks (one register for all of them)
		// votes = <18 19 20 21 27>;    // ... and enable_mask of: gcc_qupv3_wrapN_core_2x_clk, ..._core_clk, the two
		//                              // bus clocks and the engine's, as bit numbers (BIT(18) is 18)
		//                              // (tools/qupclocks.py gcc-SOC.c WRAPPER ENGINE prints these three lines)
		// bus-pins = <52 53 54 55>;    // the bus's pinctrl node: data in (MISO), data out (MOSI), clock, chip select
		// interrupt = <81>;            // the controller's node: its interrupt GPIO
		// reset = <105>;               // ... and its reset GPIO
		// io-supply = "ldoc2";         // its 1.8 V supply (vdd/iovdd-supply) by its RPMh name: L2C is "ldoc2"
		// analog-supply = "ldoc7";     // touch-ft3658u: its 3.3 V supply the same way
		// analog-enable = <107>;       // touch-goodix: the GPIO that switches its analog supply on (avdd-gpio)
		// vendor-pins = <68 96>;       // touch-goodix: the two straps that say whose controller is fitted
		// coordinates = <10800 24000>; // touch-goodix: the largest x and y it reports (goodix,panel-max-x and -y,
		//                              // or focaltech,display-coords' last two, of the controller's node);
		//                              // touch-ft3658u the same, 1080 x 2400 when it is left out
	// };

	// A touch controller on I2C, for the feature "touch-ft5x06": a FocalTech chip of the FT5x06 register family
	// (FT5x06, FT5x46, FT6x36 ...; a "focaltech,..." node under an i2c@ bus of the device tree) on two
	// of the SoC's pins, driven by hand. One with its own flash: no firmware is uploaded. Try touchscreen=-1 first.
	// touch-i2c {
		// sda = <42>;                  // the I2C bus's data line: the first pin of the bus's pinctrl node
		// scl = <43>;                  // ... and its clock, the second
		// interrupt = <59>;            // the controller's node: its interrupt GPIO (focaltech,irq-gpio)
		// reset = <58>;                // ... and its reset GPIO (focaltech,reset-gpio)
		// address = <0x38>;            // the node's reg: its I2C address
		// contacts = <10>;             // how many fingers the chip reports at most (focaltech,max-touch-number): 1 to 10
		// coordinates = <1080 2340>;   // the largest x and y it reports (focaltech,display-coords' last two), up to 4095
		// io-supply = "ldoa8";         // optional: its 1.8 V supply (vcc_i2c-supply) by its RPMh name, if a regulator of
		//                              // RPMh's that this driver is to switch: L8A is "ldoa8"; needs rpmh { } in soc.dtsi
		// analog-supply = "ldoa17";    // optional: its analog supply (vdd-supply) the same way, with what it is asked for:
		// analog-millivolts = <3008>;  // ... the regulator's voltage in the device tree, 2600 to 3600
		// analog-enable = <78>;        // optional: a GPIO that switches its analog supply on, high
	// };

	// The microphones' codec, for the feature "mic-wcd938x": a WCD938x on the SoC's SoundWire.
	// mic {
		// codec-reset = <83>;          // the codec's node: reset-gpios (qcom,wcd-rst-gpio-node's pin in vendor trees)
	// };

	// The speaker's two amplifiers, for the feature "speaker-aw88261": Awinic AW88261 on two of the SoC's
	// pins (I2C by hand), each with an address and an interrupt pin of its own.
	// speaker {
		// sda = <12>;                  // the I2C bus's data line: the first pin of the bus's pinctrl node
		// scl = <13>;                  // ... and its clock, the second
		// addresses = <0x35 0x34>;     // the two aw882xx_smartpa@NN nodes' reg; the first is the one with sound-channel 0
		// interrupts = <102 45>;       // ... and their irq-gpio, in the same order
		// sound-pins = <97 100 98 99>; // the pins the sound goes to them on (the MI2S or TDM port's pinctrl nodes):
		//                              // bit clock, frame sync (word select), data in, data out
		// sound-function = <1>;        // which of those pins' functions that is (pinctrl-SOC.c: "mi2s0_sck" is function 1)
		// tdm = <0>;                   // optional: which TDM interface of the audio DSP that port is: 0 the primary (the
		//                              // default), 1 the secondary, 2 the tertiary, 3 the quaternary, 4 the quinary
		//                              // (the sound card's dai-tdm node: qcom,msm-dai-tdm-pri-rx is 0, ...-tert-rx 2)
	// };

	// The cameras, for the feature "camera-sm7325": the sensors on an SM7325's camera blocks, their
	// supplies from a PM8008's regulators. Each sensor is one sensor@N { } table, in the order Darwin's
	// side numbers them; Android's device tree has each as a qcom,cam-sensor node (cam-sensorN).
	// camera {
		// pmic-pins = <4 5>;           // the PM8008's I2C bus: the pins of its qcom,i2c node's pinctrl, SDA then SCL
		// pmic-reset = <0x28a>;        // the PMIC GPIO its reset is on (its node's reset-gpio: <&pm8350c_gpios 3 ...>),
		//                              // as SPMI slave << 8 | the GPIO's peripheral's high byte: GPIO n is 0x88 + n - 1
		// test-sensor = "macro";       // optional: the one cam=1 to cam=4 work on (the first, if not said)
		// darwin-sensor = "wide";         // optional: Darwin's back camera, whose frames it gets with cam=5 (the first, if not said)
		// darwin-front = "front";         // optional: Darwin's front camera (none, if not said)
		//
		// sensor@0 {
			// name = "wide";       // what cam_sensor= picks it by: lower-case letters, digits and dashes
			// chip = "S5KHM2SD";   // one the driver knows: OV02B10, S5KHM2SD, OV16A1Q or S5K4H7
			// cci = <0 1>;         // the node's cci-device and cci-master
			// pins = <71 72>;      // that master's pins, SDA then SCL (the cci pinctrl node of that master)
			// reset = <21>;        // the node's gpios: the one gpio-reset names
			// mclk = <1>;          // which MCLK: the node's clock-names "cam_clk" is cam_cc_mclkN_clk
			// mclk-pin = <65>;     // ... and its pin (the gpios' first, cam_sensor_mclkN pinctrl)
			// csiphy = <1>;        // the node's csiphy-sd-index
			// vana = "gpio106 2800mV 135us"; // optional, each of the three: how the supply is switched -- "ldoN MVmV", the
			// vdig = "ldo1 1000mV"; // PM8008's LDO N at that set point (cam_vana-supply and the like name it, its
			// vio = "ldo5 1800mV"; // rgltr-min-voltage the set point), or "gpioN MVmV USus", a fixed regulator a
			//                      // pin switches (its gpio, its voltage, its startup-delay-us); left out: not switched
			// focus-motor = "dw9800"; // optional: a DW9800 moves the lens (an actuator node with compatible dw9800)
			// focus-supply = "ldoc9 2800mV"; // optional: its supply, when it is switched (the actuator's
			//                      // cam_vaf-supply: its RPMh name, and the node's rgltr-min-voltage)
			// upside-down;         // optional: its pictures come out turned half round from the way Darwin has that
			//                      // camera's -- seen on the phone: add it when Darwin shows that camera upside down
		// };
	// };

	// The vibration motor's chip, for the feature "haptic-aw86927": an Awinic AW86927 on two of the SoC's
	// pins (I2C by hand), its reset and its interrupt, and what Android's driver found for this motor.
	// haptic {
		// sda = <36>;                  // the I2C bus's data line: the first pin of the bus's pinctrl node
		// scl = <37>;                  // ... and its clock, the second
		// reset = <35>;                // the chip's node: reset-gpio
		// interrupt = <18>;            // ... and irq-gpio
		// f0-calibration = <0x0d>;     // Android's log at boot: "f0_cali_data = 0x0D" (per motor: read it on your phone)
	// };

	// The motion sensor, for the feature "imu-lsm6dso": an ST LSM6DSO (or LSM6DSOX) accelerometer and gyroscope on
	// two of the SoC's pins (I2C by hand), and how the chip is turned on the board. Only where the application
	// processor has the chip's bus: on most phones it is the sensor DSP's, and this is not for them.
	// For a Bosch BMI160 list "imu-bmi160" instead (one of the two, never both) and write the same keys: its
	// address is 0x68 with its SDO pin low, 0x69 high, its ranges the same four, and mount means the same (it too
	// reads +1 g along the axis that points up). A BMI260 or BMI270 is another chip: neither feature is for it.
	// imu {
		// sda = <116>;                 // the I2C bus's data line: the first pin of the bus's pinctrl node
		// scl = <117>;                 // ... and its clock, the second
		// interrupt = <112>;           // the chip's node: st,int1-gpio (only looked at: the driver polls)
		// address = <0x6a>;            // the chip's node: reg (0x6a with its SA0 pin low, 0x6b high)
		// full-scale = <4>;            // the accelerometer's range in g: 2, 4, 8 or 16 (4 is enough to tell which way is down)
		// mount = "-x", "-y", "-z";    // Darwin's x, y and z (right, up, out of the screen) as the chip's axes, "-"
		//                              // where Darwin's is the other way. The chip reads +1 g along the axis that
		//                              // points up and Darwin -1 g (board/orientation_core.h), so a chip square on
		//                              // the board is this; turned a quarter, "-y", "x", "-z". The chip's node's
		//                              // mount-matrix, a row of it each, says how it is turned (the signs then
		//                              // all the other way). Check it on the phone: sensors=2 says each orientation
	// };

	// The flashlight, for the feature "torch-pm8350c": the PM8350C's flash LED module and that PMIC's
	// temperature alarm, each as SPMI slave << 8 | the high byte of its registers.
	// torch {
		// flash = <0x2ee>;             // qcom,flash_led@ee00 (qcom,pm8350c-flash-led) under qcom,pm8350c@2
		// alarm = <0x20a>;             // qcom,temp-alarm@a00 of the same PMIC
	// };

	// The audio DSP, for the feature "adsp".
	// adsp {
		// firmware = "fw-audio-NAME";  // the root's directory with this phone's adsp.mdt and adsp.bNN (signed for
		//                              // the phone: take them from its own firmware partition)
		// memory = <0x86700000>;       // where the DSP's reserved memory is: the reserved-memory node that the
		//                              // memory-region of the node with qcom,firmware-name = "adsp" points at
		// memory-size = <0x03000000>;  // how much of the DSP's reserved memory the image may take: the size of the
		//                              // reserved-memory node the DSP's memory-region points at
		// charge-counter-divisor = <100>; // 100 when the battery manager counts charge in 1/100 uAh (a gauge that is
		//                              // not a BQ: Linux's qti_battery_charger.c); left out: in uAh
	// };

	// The GPU, for the feature "gpu-a660" (Documentation/drivers.md). From the SoC's -gpu.dtsi in the Android device
	// tree and the chip's entry in Linux's adreno-gpulist.h.
	// gpu {
		// model = "Adreno 642";        // for the log
		// chip-id = <0x06060010>;      // qcom,chipid
		// firmware = "fw-NAME";        // the directory of the small image with a660_gmu.bin, a660_sqe.fw and this
		//                              // phone's own a660_zap.* (signed for it: another phone's is refused)
		// gmem-kb = <1536>;            // adreno-gpulist.h: gmem_size
		// primitive-fifo = <0x00300000>; // adreno-gpulist.h: prim_fifo_threshold
		// hang-cycles = <0x3ffff>;     // adreno-gpulist.h: hang_detect_cycles
		// uche-cmdq-config = <0x66906>; // written to UCHE_CMDQ_CONFIG if given
		// speed-fuse = <0x1e1>;        // qcom,gpu-speed-bin: its place in the fuses
		// gaming-fuse = <0x1ed>;       // qcom,gpu-gaming-bin
		// highest-bank-bit = <14>;     // qcom,highest-bank-bit; 14 with LPDDR4X whatever the tree says (a6xx_init)
		// gcc-debug-gpucc = <0x13c>;   // the GPU clock controller in GCC's debug multiplexer (Linux's debugcc)
		// zap-must-authenticate;       // stop when TrustZone does not confirm the zap shader. Without it the driver
		//                              // goes on with the one presumed to remain from the firmware
		// speeds-khz = <285000 365000 443000 490000>; // qcom,gpu-pwrlevels of the phone's speed bin, slowest first
		// speed-levels = <64 80 128 144>; // the supply level of each (qcom,level / the OPP table's opp-level)
		// default-speed = <4>;         // which of them to run at, counted from 1
		// alt-model = "Adreno 643";    // qcom,gpu-models: another name for the parts with the speed bins
		// alt-bins = <0xac 0xbe>;      // ... listed here
	// };

	// The Wi-Fi radio, for the driver's layer in the kernel (board/lx.c). Left out: a WCN6750, no pool.
	// wifi {
		// radio-model = <1>;           // 0: a WCN6750 on the SoC's own bus (feature "wifi-wcn6750");
		//                              // 1: a WCN6855 on PCIe (its driver is being brought over)
		// early-pool-mb = <80>;        // memory in one piece kept for the radio's driver before user space
		//                              // fragments RAM (ath11k on PCIe wants 80 MiB); left out: none
		// dsp-memory = <0x9ae00000>;   // for "wifi-wcn6750": the Wi-Fi DSP's reserved memory, which the node with
		// dsp-memory-size = <0x01900000>; // qcom,firmware-name = "wpss" points at (memory-region): address and size
		// pins = <84 85 86>;           // optional, only looked at: the radio's enable (wlan-en), Bluetooth's reset
		//                              // and its sw-ctrl, from the Wi-Fi and Bluetooth nodes' gpios
		// supplies = "smpb7", "smpb1", "smpb8"; // optional, only looked up: RPMh's names of the regulators behind the
		//                              // radio's vdd-cx-mx, vdd-1.8-xo and vdd-1.3-rfa (qcom,rpmh-resource-name of each)
		// board-data = "bdwlan.elf";   // optional: the file of the radio's board data that the phone's Android loads
		//                              // (vendor/firmware or the modem partition: bdwlan*, bd_*.elf); board.bin if not said
		// regdb = "regdb_oem.bin";    // optional: its regulatory database, likewise; regdb.bin if not said
	// };

	// What Darwin's interface is told of the screen (components/statusbar/inject_statusbar.c). Only for a phone whose
	// front camera is a hole at the top left, where the status bar's clock would be drawn.
	// screen {
		// statusbar-leading-shift = <24>; // points (not pixels) the status bar's leading items move right
	// };

	// The loader (arch/arm64/boot/) under this phone's UEFI, which tells boards apart by the framebuffer the firmware
	// reports. Needs platform { } in the SoC file. Leave the section out while the phone is started another way.
	// loader {
		// fb-base = <0xE1000000>;      // what the loader prints at start: "display W x H at ..." (Documentation/porting.md,
		//                              // step 3). Only the emulator's board goes without.
		// log-other-cpu;               // keep notes in the log partition while a kernel starts on another core
		// uefi-charger;                // the firmware has Qualcomm's charger protocols: the loader reads the battery
		//                              // through them and hands it to the kernel (feature "battery-uefi")
	// };

	// Its UEFI, as arch/arm64/boot/mkboot.py packs it for `fastboot boot`; the build itself is in firmware/NAME/uefi/.
	// uefi {
		// fd-base = <0x9FD00000>;      // where the UEFI runs: FD_BASE of its port's memory map (BootShim's header
		//                              // says the same; mkboot.py compares them)
		// fd-size = <0x200000>;        // the size of SILICIUM_UEFI.fd
		// header-version = <1>;        // the Android boot image header its bootloader takes (default 1)
	// };

	// How darwin/tools/boot26.py starts this phone (--board NAME).
	// boot {
		// fastboot-product = "codename"; // what `fastboot getvar product` must answer: the tool refuses any other phone
		// cpus = <8>;                  // how many cores the kernel is given
		// bootargs = "cpufreq=1", "backlight=1"; // the boot arguments of a plain run, NAME or NAME=VALUE each;
		//                              // `--boot-arg NAME=VALUE` adds to these or replaces one (Documentation/boot-args.md)
	// };

	// Bluetooth H4, for the feature "bluetooth-wcn-uart": the values below are illustrative; fill them in from the
	// board's UART and power nodes. bt=-1 inspects, bt=1 powers and identifies, bt=2 sends the firmware named below
	// and hands the controller to Darwin. Leave the section out on a phone without the part.
	// bluetooth {
		// serial-engine = <0x898000>;     // UART SE register page
		// wrapper = <0x8c0000>;           // QUP wrapper common registers (HW_VER at +4)
		// clocks = <0x23298 0x2329c 0x1e76c>; // GCC halt offsets: m_ahb, s_ahb, SE
		// clock-source = <0x1e77c>;       // GCC CMD_RCGR offset, independent of SE halt
		// vote-register = <0x52010>;      // GCC application processor votes
		// votes = <3 0 2 1 10>;           // core_2x, core, m_ahb, s_ahb, SE bit numbers
		// uart-pins = <24 25 26 27>;      // TLMM CTS, RTS, TX, RX, in that order
		// uart-function = <1>;           // TLMM alternate function
		// enable-ppid = <0x38a>;          // PMIC GPIO: (sid << 8) | (base >> 8)
		// sw-ctrl = <18>;                // TLMM input, controller ready
		// supplies = "L2D_E0", "S2D_E0", "S4D_E0", "S4F_E0", "L3D_E0", "S3D_E0"; // RPMh VRM names, power order
		// supply-mv = <1800 864 1840 1256 1200 2156>; // millivolts, same order
		// rf-clock = "C1A_E0";            // VRM clock: enable register at resource address +4
		// firmware = "fw-bt";          // the small image's directory with the controller's firmware (default fw)
		// rampatch = "msbtfw11.mbn";   // the patch to its ROM, from the phone's own vendor/firmware (bt_fw=0: not sent)
		// nvm = "msnv11.bin";          // its configuration, sent after the patch; without either the ROM runs as it is
	// };
};
